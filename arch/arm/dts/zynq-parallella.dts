/*
 * CAUTION: This file is automatically generated by Xilinx.
 * Version: HSI 2017.3
 * Today is: Sat Dec  2 06:26:38 2017
 */


/dts-v1/;
/include/ "zynq-7000.dtsi"
/* /include/ "zcu102-rev1.0.dtsi" */
/include/ "pcw.dtsi"
/ {
	chosen {
		bootargs = "earlycon";
		stdout-path = "serial0:115200n8";
	};
	aliases {
		serial0 = &uart1;
		spi0 = &qspi;
	};
	memory {
		device_type = "memory";
		reg = <0x0 0x40000000>;
	};
};
